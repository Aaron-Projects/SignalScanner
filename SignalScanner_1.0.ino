#include <string.h>
//Libraries for screen
#include <Wire.h>
#include <Adafruit_GFX.h>
#include <Adafruit_SSD1306.h>

//Libraries for wifi
#include <WiFi.h>

// Define OLED screen resolution
#define SCREEN_WIDTH 128
#define SCREEN_HEIGHT 64

//buttons
#define LEFT 18
#define RIGHT 5
#define SELECT 19
#define BACK 14

// Define OLED I2C address (default is usually 0x3C or 0x3D)
#define OLED_ADDR   0x3C

// Create OLED object
Adafruit_SSD1306 display(SCREEN_WIDTH, SCREEN_HEIGHT, &Wire, -1);

// 'WiFi_BMP', 42x40px
const unsigned char WiFi_BMP [] PROGMEM = {
	0x00, 0x00, 0x00, 0x00, 0x00, 0x00, 0x00, 0x00, 0x00, 0x00, 0x00, 0x00, 0x00, 0x00, 0x00, 0x00, 
	0x00, 0x00, 0x00, 0x00, 0x00, 0x00, 0x00, 0x00, 0x00, 0x00, 0x00, 0x00, 0x00, 0x00, 0x00, 0x1f, 
	0xff, 0xfe, 0x00, 0x00, 0x00, 0xff, 0xff, 0xff, 0xc0, 0x00, 0x01, 0xff, 0xff, 0xff, 0xe0, 0x00, 
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	0x00, 0x00, 0x00, 0x00, 0x00, 0x00, 0x00, 0x00, 0x00, 0x00, 0x00, 0x00, 0x00, 0x00, 0x00, 0x00
};
// 'BTooth_BMP', 42x40px
const unsigned char BTooth_BMP [] PROGMEM = {
	0x00, 0x00, 0x00, 0x00, 0x00, 0x00, 0x00, 0x00, 0x00, 0x00, 0x00, 0x00, 0x00, 0x00, 0x00, 0x00, 
	0x00, 0x00, 0x00, 0x00, 0x00, 0x00, 0x00, 0x00, 0x00, 0x00, 0x00, 0x00, 0x00, 0x00, 0x00, 0x00, 
	0x00, 0x00, 0x00, 0x00, 0x00, 0x06, 0x00, 0x18, 0x00, 0x00, 0x00, 0x0f, 0x00, 0x3c, 0x00, 0x00, 
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	0x00, 0x00, 0x00, 0x00, 0x00, 0x00, 0x00, 0x00, 0x00, 0x00, 0x00, 0x00, 0x00, 0x00, 0x00, 0x00
};


void MenuScreen(bool choice);
void LoadingScreen();
void wifiScanning();
int buttonPress(int pin);

int buttonPress(int pin){
  bool press{false};
  
  if(!digitalRead(pin)){
    press=true;
    while(!digitalRead(pin)) {
      delay(50);
    }
  }
  if(press==true){
    Serial.print(F("Button Press detected at pin: "));
    Serial.println(pin);
    return pin;
  }
  else {
    return 0;
  }
}

void LoadingScreen(){
  display.clearDisplay();
  display.setCursor(6,25);
	display.setTextSize(2);
  display.print(F("Loading..."));
  display.display();
}

void MenuScreen(bool choice){
	display.clearDisplay();
	display.setCursor(0,0);
	display.setTextSize(1); // 8 vertical pixels per line
	display.println(F("Select Signal Type To Search For:"));
	display.drawBitmap(10,20,WiFi_BMP,42,40,SSD1306_WHITE);
	display.drawBitmap(74,20,BTooth_BMP,42,40,SSD1306_WHITE);
	if(choice==0){
		display.drawRect(9, 20, 44, 42, SSD1306_WHITE);
	}
	else if(choice==1){
		display.drawRect(72, 20, 46, 42, SSD1306_WHITE);
	}
	display.display();
}

bool initialScanWiFi{false};
int NumOfNetworks{0};
void wifiScanning(){
	int HN{1};
	unsigned long T_load=millis();
	if(!initialScanWiFi){
		LoadingScreen();
		NumOfNetworks = WiFi.scanNetworks(false, true); /*
		first true makes scanning asynchronous and exits function
		second true shows networks with hidden network ids
		-->WiFi.scanNetworks(async, show_hidden)
		*/
		initialScanWiFi=true;
	}
	else{
		WiFi.scanDelete();
		NumOfNetworks=WiFi.scanNetworks(false, true);
	}
	display.clearDisplay();
	display.setCursor(0,0);
	display.setTextSize(1);//8 vertical pixels = 1 line
	for(int i=0;i<NumOfNetworks;i++){
		if(WiFi.SSID(i)==""){//wifi library returns hidden network ssids as empty string
			Serial.printf("HiddenNetwork%d", (HN));
			display.print("HiddenNetwork");
			display.print(HN);
			HN++;
		}
		else{	
			Serial.print(WiFi.SSID(i));
			display.print(WiFi.SSID(i));
		}
		
		/*Commented out, find a function/way to check security of network
		if(WiFi.isHidden(i)){
			Serial.print(F("*"));
			display.print(F("*"));
		}*/
		Serial.print(F("	"));
		Serial.println(WiFi.RSSI(i));
		int Y=display.getCursorY();
		display.setCursor(104,Y);
		display.println(WiFi.RSSI(i));
	}
	display.display();
}

unsigned long prevMillis;
void setup() {
  // put your setup code here, to run once:
	prevMillis=millis();
	Serial.begin(9600);
	//button setup
  pinMode(LEFT, INPUT_PULLUP);
  pinMode(RIGHT, INPUT_PULLUP);
  pinMode(SELECT, INPUT_PULLUP);
  pinMode(BACK, INPUT_PULLUP);
  // Initialize OLED screen
  Wire.begin(21,22);
  if(!display.begin(SSD1306_SWITCHCAPVCC, OLED_ADDR)) {
    Serial.println(F("SSD1306 allocation failed"));
    for(;;); // Infinite loop to terminate program
  }
  // Clear display buffer
  display.clearDisplay();
  // Set text size and color
  display.setTextColor(SSD1306_WHITE);
	WiFi.mode(WIFI_STA);
}

bool ScanMode{0};// must be set or stays on menu 
bool ScanType{0};//defaults to wifi
void loop() {
	int buttons[4]={LEFT,RIGHT,SELECT,BACK};
	int presses[4]={0,0,0,0};
	if(!ScanMode){
		MenuScreen(ScanType);
		presses[0]=buttonPress(buttons[0]);
		presses[1]=buttonPress(buttons[1]);
		presses[2]=buttonPress(buttons[2]);

		if(presses[0]){
			ScanType=0; //highlights wifi scanning mode
		}
		if(presses[1]){
			ScanType=1; //highlights bluetooth scanning mode
		}
		if(presses[2]){
			ScanMode=1;
		}
	}
	else if(ScanMode){
		presses[3]=buttonPress(buttons[3]);
		if(presses[3]){
			ScanMode=0;
			WiFi.scanDelete();
			initialScanWiFi=false;
			return;
		}
		else if(ScanType==0){
			wifiScanning();
		}
		else{
			LoadingScreen(); //as placeholder
		}
	}

	//wifiScanning();
}
