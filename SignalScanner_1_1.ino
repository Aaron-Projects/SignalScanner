#include <string.h>
//Libraries for screen
#include <Wire.h>
#include <Adafruit_GFX.h>
#include <Adafruit_SSD1306.h>

//Library for wifi
#include <WiFi.h>
//Library For Bluetooth (BLE)
#include "NimBLEDevice.h"

// Define OLED screen resolution
#define SCREEN_WIDTH 128
#define SCREEN_HEIGHT 64

//buttons
#define LEFT 18
#define RIGHT 5
#define SELECT 19
#define BACK 14

// Define OLED I2C address (default is usually 0x3C or 0x3D)
#define OLED_ADDR   0x3C

// Create OLED object
Adafruit_SSD1306 display(SCREEN_WIDTH, SCREEN_HEIGHT, &Wire, -1);

//BITMAPS for menu screen --> intend to optimise the size at a later date
// 'WiFi_BMP', 42x40px
const unsigned char WiFi_BMP [] PROGMEM = {
	0x00, 0x00, 0x00, 0x00, 0x00, 0x00, 0x00, 0x00, 0x00, 0x00, 0x00, 0x00, 0x00, 0x00, 0x00, 0x00, 
	0x00, 0x00, 0x00, 0x00, 0x00, 0x00, 0x00, 0x00, 0x00, 0x00, 0x00, 0x00, 0x00, 0x00, 0x00, 0x1f, 
	0xff, 0xfe, 0x00, 0x00, 0x00, 0xff, 0xff, 0xff, 0xc0, 0x00, 0x01, 0xff, 0xff, 0xff, 0xe0, 0x00, 
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	0x00, 0x00, 0x00, 0x00, 0x00, 0x00, 0x00, 0x00, 0x00, 0x00, 0x00, 0x00, 0x00, 0x00, 0x00, 0x00
};
// 'BTooth_BMP', 42x40px
const unsigned char BTooth_BMP [] PROGMEM = {
	0x00, 0x00, 0x00, 0x00, 0x00, 0x00, 0x00, 0x00, 0x00, 0x00, 0x00, 0x00, 0x00, 0x00, 0x00, 0x00, 
	0x00, 0x00, 0x00, 0x00, 0x00, 0x00, 0x00, 0x00, 0x00, 0x00, 0x00, 0x00, 0x00, 0x00, 0x00, 0x00, 
	0x00, 0x00, 0x00, 0x00, 0x00, 0x06, 0x00, 0x18, 0x00, 0x00, 0x00, 0x0f, 0x00, 0x3c, 0x00, 0x00, 
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	0x00, 0x00, 0x00, 0x00, 0x00, 0x00, 0x00, 0x00, 0x00, 0x00, 0x00, 0x00, 0x00, 0x00, 0x00, 0x00
};


void MenuScreen(bool choice);
void LoadingScreen();
void wifiScanning();
void BLEScanning();
uint8_t buttonPress(uint8_t pin);
void resetDisplay(
	uint8_t CursorX=0,
	uint8_t CursorY=0,
	uint8_t textSize=1
	);

void  resetDisplay(uint8_t CursorX, uint8_t CursorY, uint8_t textSize){
	display.clearDisplay();//REPLACE WITH FUNCTION
	display.setCursor(CursorX,CursorY);
	display.setTextWrap(true);
	display.setTextSize(textSize);//8 vertical pixels = 1 line

}

uint8_t buttonPress(uint8_t pin){
  bool press{false};
  
  if(!digitalRead(pin)){
    press=true;
    while(!digitalRead(pin)) {
    //while loop waits for user to lift finger off button
      delay(50); //delay to debounce the button press/ignore "mechanical noise"
			//blocking statement better to prevent erroneous execution of code
		}
  }
  if(press){
    Serial.print(F("Button Press detected at pin: "));
    Serial.println(pin);
    return pin;
  }
  else {
    return 0;
  }
}

void LoadingScreen(){
	resetDisplay(6,25,2);
  display.print(F("Loading..."));
  display.display();
}

void MenuScreen(bool choice){
	resetDisplay();
	display.println(F("Select Signal Type To Search For:"));
	display.drawBitmap(10,20,WiFi_BMP,42,40,SSD1306_WHITE);
	display.drawBitmap(74,20,BTooth_BMP,42,40,SSD1306_WHITE);
	if(choice==0){
		display.drawRect(9, 20, 44, 42, SSD1306_WHITE);
	}
	else if(choice==1){
		display.drawRect(72, 20, 46, 42, SSD1306_WHITE);
	}
	display.display();
}

bool initialScanWiFi{false};
int NumOfNetworks{0};
void wifiScanning(){
	WiFi.mode(WIFI_STA);
	uint8_t HN{1};
	uint8_t PageCount{0};
	//unsigned long T_load=millis();
	if(!initialScanWiFi){
		LoadingScreen();
		NumOfNetworks = WiFi.scanNetworks(false, true); /*
		first true makes scanning asynchronous and exits function
		second true shows networks with hidden network ids
		-->WiFi.scanNetworks(async, show_hidden)
		*/
		initialScanWiFi=true;
	}
	else{
		WiFi.scanDelete();
		NumOfNetworks=WiFi.scanNetworks(false, true);
	}
	resetDisplay();
	display.println("Scan Mode set to WIFI");
	display.println("<DeviceName>	<RSSI>");
	for(uint8_t i=0;i<NumOfNetworks;i++){
		if(WiFi.SSID(i)==""){//wifi library returns hidden network ssids as empty string
			Serial.printf("HiddenNetwork%d", (HN));
			display.print("HiddenNetwork");
			display.print(HN);
			HN++;
		}
		else{	
			Serial.print(WiFi.SSID(i));
			display.print(WiFi.SSID(i));
		}
		//To do: find a simple way to indicate security of a given network
		Serial.print(F("	"));
		Serial.println(WiFi.RSSI(i));
		//int Y=display.getCursorY(); commented out to test textwrap
		//display.setCursor(104,Y);
		display.printf("(%d)\n", WiFi.RSSI(i));
	}
	display.display();
}
bool initialBLEScan{false};
void BLEScanning(){
	if(!initialBLEScan){
		NimBLEDevice::init(""); 
		NimBLEScan* pBLEScan = NimBLEDevice::getScan(); 
		LoadingScreen();
		NimBLEScanResults results = pBLEScan->getResults(10*1000);
		resetDisplay();
		display.println("Scan Mode set to BLE");
		display.println("<DeviceName>	<RSSI>");
		for(int i=0;i<results.getCount();i++){
			const NimBLEAdvertisedDevice *device = results.getDevice(i);
			if(device->haveName()){
				Serial.printf("Device: %s    RSSI: %d\n", device->getName().c_str(), device->getRSSI());
				display.print(device->getName().c_str());
				display.printf("(%d)", device->getRSSI());
				display.println();
			}
		}
		display.display();
		initialBLEScan=true;
		pBLEScan->clearResults();
	}
}



//unsigned long prevMillis;
void setup() {
  // put your setup code here, to run once:
	//prevMillis=millis();
	Serial.begin(9600);
	//button setup
  pinMode(LEFT, INPUT_PULLUP);
  pinMode(RIGHT, INPUT_PULLUP);
  pinMode(SELECT, INPUT_PULLUP);
  pinMode(BACK, INPUT_PULLUP);
  // Initialize OLED screen
  Wire.begin(21,22);
  if(!display.begin(SSD1306_SWITCHCAPVCC, OLED_ADDR)) {
    Serial.println(F("SSD1306 allocation failed"));
    for(;;); // Infinite loop to terminate program
  }
  // Clear display buffer
  display.clearDisplay();
  // Set text size and color
  display.setTextColor(SSD1306_WHITE);
}

bool ScanMode{0};// must be set or stays on menu 
bool ScanType{0};//defaults to wifi
void loop() {
	int presses[4]={0,0,0,0};//{LEFT,RIGHT,SELECT,BACK};
	if(!ScanMode){
		MenuScreen(ScanType);
		presses[0]=buttonPress(LEFT);
		presses[1]=buttonPress(RIGHT);
		presses[2]=buttonPress(SELECT);

		if(presses[0]){
			ScanType=0; //highlights wifi scanning mode
		}
		if(presses[1]){
			ScanType=1; //highlights bluetooth scanning mode
		}
		if(presses[2]){
			ScanMode=1;
		}
	}
	else if(ScanMode){
		presses[3]=buttonPress(BACK);// back button only active if a mode selected
		if(presses[3]){
			ScanMode=0;
			if(!ScanType){
				WiFi.scanDelete();
				WiFi.mode(WIFI_OFF);
				initialScanWiFi=false;

			}
			else{
				initialBLEScan=false;
			}
			return;
		}
		else if(ScanType==0){
			wifiScanning();
		}
		else if(ScanType==1){
			BLEScanning(); //as placeholder
		}
	}
}
